## CMakeLists.txt
```
cmake_minimum_required(VERSION 3.20.0)

# Apply patches before build
file(GLOB_RECURSE files RELATIVE ${CMAKE_SOURCE_DIR} "patches/*.patch")
foreach(file ${files})
    execute_process(COMMAND 
                    patch -p1 -d ../zephyr/ -i ${CMAKE_CURRENT_SOURCE_DIR}/${file} -r - --no-backup-if-mismatch)
endforeach()

string(REGEX MATCH "zswatch_nrf5340_cpuapp(_ns)?@([0-9]+)$" ZSWATCH_BOARD "${BOARD}")
if(ZSWATCH_BOARD)
    set(ZSWATCH_REV ${CMAKE_MATCH_2})
    add_definitions(-DZSWATCH_REV=${ZSWATCH_REV})
    # Rev 3 and later will handle this later in a different way.
    if(${ZSWATCH_REV} EQUAL 2)
        set(DFU_BUILD true)
        set(PM_STATIC_YML_FILE ${CMAKE_CURRENT_SOURCE_DIR}/partition.yml)
        set(OVERLAY_CONFIG ${CMAKE_CURRENT_SOURCE_DIR}/boards/dfu.conf)
        set(mcuboot_DTC_OVERLAY_FILE ${CMAKE_CURRENT_SOURCE_DIR}/overlays/mcuboot.overlay)
    endif()
endif()

set(BOARD_ROOT ${CMAKE_CURRENT_SOURCE_DIR})
find_package(Zephyr REQUIRED HINTS $ENV{ZEPHYR_BASE})
project(ZSWatchFW)

#add_subdirectory(drivers)
add_subdirectory(src/applications)
add_subdirectory(src/ext_drivers/bmi270)
add_subdirectory(src/ext_drivers/bmp581)

include_directories(src/)
include_directories(src/ui)
include_directories(src/applications)

target_sources(app PRIVATE src/main.c)
target_sources(app PRIVATE src/ram_retention_storage.c)
target_sources(app PRIVATE src/zsw_clock.c)
target_sources(app PRIVATE src/zsw_cpu_freq.c)

target_sources(app PRIVATE src/drivers/zsw_display_control.c)
target_sources(app PRIVATE src/drivers/zsw_vibration_motor.c)

target_sources(app PRIVATE src/managers/zsw_app_manager.c)
target_sources(app PRIVATE src/managers/zsw_notification_manager.c)
target_sources(app PRIVATE src/managers/zsw_battery_manager.c)
target_sources(app PRIVATE src/managers/zsw_power_manager.c)
target_sources(app PRIVATE src/managers/zsw_phone_app_publisher.c)

target_sources(app PRIVATE src/battery/battery.c)
target_sources(app PRIVATE src/battery/zsw_charger.c)

target_sources(app PRIVATE src/ble/ble_aoa.c)
target_sources(app PRIVATE src/ble/ble_comm.c)
target_sources(app PRIVATE src/ble/ble_transport.c)
target_sources(app PRIVATE src/ble/zsw_gatt_sensor_server.c)

target_sources(app PRIVATE src/sensors/zsw_imu.c)
target_sources(app PRIVATE src/sensors/zsw_pressure_sensor.c)
target_sources(app PRIVATE src/sensors/zsw_magnetometer.c)

target_sources(app PRIVATE src/ui/notification/zsw_popup_notifcation.c)
target_sources(app PRIVATE src/ui/popup/zsw_popup_window.c)
target_sources(app PRIVATE src/ui/utils/zsw_ui_utils.c)

target_sources_ifdef(CONFIG_SPI_FLASH_LOADER app PRIVATE src/filesystem/zsw_rtt_flash_loader.c)
target_sources_ifdef(CONFIG_FILE_SYSTEM_LITTLEFS app PRIVATE src/filesystem/zsw_filesystem.c)
target_sources_ifdef(CONFIG_FILE_SYSTEM_LITTLEFS app PRIVATE src/filesystem/zsw_lvgl_spi_decoder.c)

if (DFU_BUILD)
    target_sources(app PRIVATE src/dfu.c)
endif()

FILE(GLOB img_sources src/images/*.c)
target_sources(app PRIVATE ${img_sources})

FILE(GLOB font_sources src/images/fonts/*.c)
target_sources(app PRIVATE ${font_sources})

zephyr_sources_ifdef(CONFIG_WATCHFACE_ANALOG src/ui/watchfaces/zsw_watchface_analog_ui.c)
zephyr_sources_ifdef(CONFIG_WATCHFACE_DIGITAL src/ui/watchfaces/zsw_watchface_digital_ui.c)
zephyr_sources_ifdef(CONFIG_WATCHFACE_MINIMAL src/ui/watchfaces/zsw_watchface_minimal_ui.c)

FILE(GLOB events_sources src/events/*.c)
target_sources(app PRIVATE ${events_sources})

add_compile_definitions(LV_LVGL_H_INCLUDE_SIMPLE)
```

## Kconfig
```
menu "Zephyr Kernel"
    source "Kconfig.zephyr"
endmenu

menu "ZSWatch"
    menu "Applications"
        config APPLICATIONS_USE_2048
            bool
        prompt "Activate the application '2048'"
        default y

        config APPLICATIONS_USE_ACCELEROMETER
            bool
        prompt "Activate the application 'Accelerometer'"
        default y

        config APPLICATIONS_USE_BATTERY
            bool
        prompt "Activate the application 'Battery'"
        default y

        config APPLICATIONS_USE_COMPASS
            bool
        prompt "Activate the application 'Compass'"
        default y

        config APPLICATIONS_USE_INFO
            bool
        prompt "Activate the application 'Info'"
        default y

        config APPLICATIONS_USE_QR_CODE
            bool
        prompt "Activate the application 'QR-Code'"
        default y if LV_Z_USE_FILESYSTEM

        config APPLICATIONS_USE_SENSORS_SUMMARY
            bool
        prompt "Activate the application 'Sensors Summary'"
        default y

        config APPLICATIONS_USE_X_RAY
            bool
        prompt "Activate the application 'X-Ray'"
        default y if LV_Z_USE_FILESYSTEM

        config APPLICATIONS_USE_ZDS
            bool
        prompt "Activate the application 'ZDS'"
        default n
        select APPLICATIONS_USE_ACCELEROMETER

        config APPLICATIONS_USE_IAQ
            bool
        prompt "Activate the application 'IAQ'"
        depends on EXTERNAL_USE_BOSCH_BSEC && LV_Z_USE_FILESYSTEM
        default n
    endmenu

    menu "Watchface"
        config WATCHFACE_ANALOG
            bool
            prompt "Add analog watchface"
            default n

        config WATCHFACE_DIGITAL
            bool
            prompt "Add digital watchface"
            default y

        config WATCHFACE_MINIMAL
            bool
            prompt "Add minimal watchface"
            default y

        choice WATCHFACE_BACKGROUND_IMG
            bool
            prompt "Select which watchface background imgage to use. Not all watchfaces supports this."
            def_bool WATCHFACE_BACKGROUND_SPACE

        config WATCHFACE_BACKGROUND_SPACE
            prompt "Space themed background"
        config WATCHFACE_BACKGROUND_FLOWER
            prompt "Flower themed background"
        config WATCHFACE_BACKGROUND_PLANET
            prompt "Planet earth themed background"
        config WATCHFACE_BACKGROUND_NONE
            prompt "No background"
        endchoice
    endmenu

    menu "Default configuration"
        menu "Sensors Summary"
            depends on APPLICATIONS_USE_SENSORS_SUMMARY

            config DEFAULT_CONFIGURATION_SENSORS_SUMMARY_REFRESH_INTERVAL_MS
                int
            prompt "Refresh interval in milliseconds"
            default 100
        endmenu

        menu "Compass"
            depends on APPLICATIONS_USE_COMPASS

            config DEFAULT_CONFIGURATION_COMPASS_REFRESH_INTERVAL_MS
                int
            prompt "Refresh interval in milliseconds"
            default 50

            config DEFAULT_CONFIGURATION_COMPASS_CALIBRATION_TIME_S
                int
            prompt "Calibration time in seconds"
            default 10
        endmenu

        menu "Battery"
            depends on APPLICATIONS_USE_BATTERY

            config DEFAULT_CONFIGURATION_BATTERY_NUM_SAMPLES_MAX
                int
            prompt "Maximum number of samples"
            default 100

            config DEFAULT_CONFIGURATION_BATTERY_SAMPLE_INTERVAL_MINUTES
                int
            prompt "Battery sample interval in minutes"
            default 30
        endmenu

        menu "Power Management"
            config POWER_MANAGEMENT_IDLE_TIMEOUT_SECONDS
                int
            prompt "Idle timeout in seconds"
            default 20
        endmenu
    endmenu

    menu "External"
        choice EXTERNAL_BOSCH_SENSOR
            bool
            prompt "Select the function for the Bosch environment sensor."
            help
                You have to disable the BME680 option in the Zephyr configuration to enable the Bosch BSEC option.
            def_bool EXTERNAL_USE_BOSCH_BME688

        config EXTERNAL_USE_BOSCH_BSEC
            prompt "Use Bosch BSEC library"
            depends on !BME680
            select BME68X_IAQ

        config EXTERNAL_USE_BOSCH_BME688
            prompt "Use standard BME688 driver"
        endchoice
    endmenu

    menu "BLE"
        config BLE_DISABLE_PAIRING_REQUIRED
            bool
        prompt "Disable encryption required for BLE connection (pairing/bonding)"
        default n
        help
            "Disable encryption for BLE connection (pairing/bonding). Used only for debugging purposes."
   		config BLE_SUPPORT_AOA
			bool
		prompt "support aoa feature"
		default n
		help
			"Disable if not support"
	 endmenu
    
    menu "SPI RTT Flash Loader"
        config SPI_FLASH_LOADER
            bool
        prompt "Enable SPI flash loader"
        default n
        select USE_SEGGER_RTT
        #select SEGGER_RTT_MODE_BLOCK_IF_FIFO_FULL
        help
            "Enable SPI flash loader"

        if SPI_FLASH_LOADER
            config ERASE_PROGRESSIVELY
                bool
            depends on SPI_FLASH_LOADER
            prompt "Erase sectors one by one when writing instead of full partition before starting."
            default y
            help
                "If not writing to the full partition this will be faster"

            config RTT_TRANSFER_CHANNEL
                int
            depends on SPI_FLASH_LOADER
            prompt "The RTT channel to use for transfer of data to and form flash"
            default 2
            help
                "If RTT logging is enabled, channel 0 is used for this, hence avoid 1 in this scenario."
        endif
    endmenu

    menu "ZSWatch Init Priorities"
    config ZSW_DRIVER_INIT_PRIORITY
        int
        default 85
    endmenu

    menu "Custom drivers"
        rsource "drivers/Kconfig"
    endmenu
endmenu



module = APP
module-str = APP
source "subsys/logging/Kconfig.template.log_config"
```

## prj.conf
```kconfig
CONFIG_MAIN_STACK_SIZE=2048
CONFIG_SYSTEM_WORKQUEUE_STACK_SIZE=4096
CONFIG_HEAP_MEM_POOL_SIZE=25000
CONFIG_NEWLIB_LIBC_FLOAT_PRINTF=y
CONFIG_CBPRINTF_FP_SUPPORT=y

CONFIG_ASSERT=y
CONFIG_REBOOT=y
CONFIG_DISPLAY=y
CONFIG_BASE64=y

#CONFIG_RETAINED_MEM=y
#CONFIG_RETENTION=y
#CONFIG_RETENTION_BOOT_MODE=y

CONFIG_I2C=y
CONFIG_SENSOR=y
CONFIG_ADC=y
CONFIG_BMI270=n
CONFIG_LIS2MDL=n
CONFIG_LIS2MDL_MAG_ODR_RUNTIME=n

CONFIG_PINCTRL=y
CONFIG_PM_DEVICE=y
CONFIG_PM_DEVICE_RUNTIME=y

CONFIG_PWM=y

CONFIG_SPI=y
CONFIG_INPUT=y

# LVGL configuration
CONFIG_LVGL=y
CONFIG_LV_Z_FLUSH_THREAD=y
CONFIG_LV_Z_FLUSH_THREAD_PRIO=0
CONFIG_LV_Z_MEM_POOL_NUMBER_BLOCKS=4
CONFIG_LV_MEM_CUSTOM=y
CONFIG_LV_FONT_MONTSERRAT_10=y
CONFIG_LV_FONT_MONTSERRAT_12=y
CONFIG_LV_FONT_MONTSERRAT_14=y
CONFIG_LV_FONT_MONTSERRAT_16=y
CONFIG_LV_FONT_MONTSERRAT_18=y
CONFIG_LV_FONT_MONTSERRAT_20=y
CONFIG_LV_Z_POINTER_INPUT_MSGQ_COUNT=200
CONFIG_LV_Z_POINTER_INPUT=y

# Comment out to show FPS counter
CONFIG_LV_USE_PERF_MONITOR=y
CONFIG_LV_PERF_MONITOR_ALIGN_RIGHT_MID=y

CONFIG_LV_Z_DOUBLE_VDB=n
CONFIG_LV_Z_VDB_SIZE=5
CONFIG_LV_DISP_DEF_REFR_PERIOD=30
CONFIG_LV_INDEV_DEF_READ_PERIOD=30

CONFIG_LV_THEME_DEFAULT_DARK=y

# LVGL Size optimizations
CONFIG_LV_LABEL_TEXT_SELECTION=n
CONFIG_LV_LABEL_LONG_TXT_HINT=n
CONFIG_LV_USE_LOG=n
CONFIG_LV_USE_BAR=y
CONFIG_LV_USE_CANVAS=n
CONFIG_LV_USE_CHECKBOX=n
CONFIG_LV_USE_DROPDOWN=n
CONFIG_LV_USE_LINE=y
CONFIG_LV_USE_ROLLER=n
CONFIG_LV_USE_SLIDER=y
CONFIG_LV_USE_SWITCH=y
CONFIG_LV_USE_TABLE=n
CONFIG_LV_USE_TEXTAREA=n
CONFIG_LV_USE_FLEX=y
CONFIG_LV_USE_ANIMIMG=y
CONFIG_LV_USE_CALENDAR=n
CONFIG_LV_USE_CHART=y
CONFIG_LV_USE_COLORWHEEL=n
CONFIG_LV_USE_IMGBTN=y
CONFIG_LV_USE_KEYBOARD=n
CONFIG_LV_USE_LED=n
CONFIG_LV_USE_LIST=y
CONFIG_LV_USE_MENU=y
CONFIG_LV_USE_METER=y
CONFIG_LV_USE_MSGBOX=y
CONFIG_LV_USE_SPINBOX=n
CONFIG_LV_USE_SPINNER=n
CONFIG_LV_USE_TABVIEW=n
CONFIG_LV_USE_TILEVIEW=n
CONFIG_LV_USE_WIN=n
CONFIG_LV_USE_SPAN=n
CONFIG_LV_USE_USER_DATA=y

CONFIG_LV_COLOR_16_SWAP=y
CONFIG_LV_COLOR_DEPTH_16=y

#
# Memory settings
#
# CONFIG_LV_MEM_CUSTOM is not set
CONFIG_LV_MEM_SIZE_KILOBYTES=25
CONFIG_LV_MEM_ADDR=0x0
CONFIG_LV_MEM_BUF_MAX_NUM=16
# end of Memory settings

# NVS
CONFIG_FLASH=y
CONFIG_FLASH_MAP=y
CONFIG_MPU_ALLOW_FLASH_WRITE=y
CONFIG_FLASH_PAGE_LAYOUT=y
CONFIG_FLASH_MAP_LABELS=y

CONFIG_SETTINGS=y
CONFIG_NVS=y
CONFIG_SETTINGS_NVS=y

# Bluetooth
CONFIG_BT=y
CONFIG_BT_HCI=y
CONFIG_BT_CTLR=n
# Enable Direction Finding TX Feature including AoA and AoD
#CONFIG_BT_DF=y
#CONFIG_BT_DF_CONNECTIONLESS_CTE_TX=y
# Enable chaining of multiple CTEs in periodic advertising
CONFIG_BT_DEBUG_LOG=y
CONFIG_BT_SMP=y
CONFIG_BT_PERIPHERAL=y
CONFIG_BT_DIS=y
CONFIG_BT_DIS_PNP=n
CONFIG_BT_BAS=y
CONFIG_BT_HRS=n
CONFIG_BT_DEVICE_NAME="ZSWatch"
CONFIG_BT_DEVICE_APPEARANCE=194
CONFIG_BT_KEYS_OVERWRITE_OLDEST=y
CONFIG_BT_SETTINGS=y
CONFIG_BT_MAX_PAIRED=5
CONFIG_BT_MAX_CONN=1
CONFIG_BT_GATT_CLIENT=y
CONFIG_BT_GATT_CACHING=y
CONFIG_BT_GATT_NOTIFY_MULTIPLE=y

#CONFIG_BT_EXT_ADV=y
#CONFIG_BT_PER_ADV=y

CONFIG_BT_BROADCASTER=y
CONFIG_BT_SMP_ALLOW_UNAUTH_OVERWRITE=y
CONFIG_BT_ECC=y
#CONFIG_BT_EXT_ADV_MAX_ADV_SET=2
CONFIG_BT_CONN_TX_MAX=3

CONFIG_BT_L2CAP_TX_MTU=498
CONFIG_BT_BUF_ACL_RX_SIZE=502
CONFIG_BT_BUF_ACL_TX_SIZE=502

# Allows to do some basic UI tasks in BT callbacks.
CONFIG_BT_RX_STACK_SIZE=3000

CONFIG_NEWLIB_LIBC=y
CONFIG_POSIX_API=y

# By default disable UART to save power
#CONFIG_SERIAL=n
#CONFIG_CONSOLE=n
#CONFIG_UART_CONSOLE=n

CONFIG_ZBUS=y
CONFIG_ZBUS_RUNTIME_OBSERVERS=y
CONFIG_ZBUS_CHANNEL_NAME=y
CONFIG_ZBUS_OBSERVER_NAME=y

# Choose one or many of below
CONFIG_WATCHFACE_ANALOG=y
CONFIG_WATCHFACE_DIGITAL=y
CONFIG_WATCHFACE_MINIMAL=y

# Choose one of below
CONFIG_WATCHFACE_BACKGROUND_SPACE=y
CONFIG_WATCHFACE_BACKGROUND_FLOWER=n
CONFIG_WATCHFACE_BACKGROUND_PLANET=n
CONFIG_WATCHFACE_BACKGROUND_NONE=n

# Default watch
CONFIG_POWER_MANAGEMENT_IDLE_TIMEOUT_SECONDS=20
CONFIG_DEFAULT_CONFIGURATION_SENSORS_SUMMARY_REFRESH_INTERVAL_MS=100
CONFIG_DEFAULT_CONFIGURATION_BATTERY_NUM_SAMPLES_MAX=100
CONFIG_DEFAULT_CONFIGURATION_BATTERY_SAMPLE_INTERVAL_MINUTES=30

# save resource
CONFIG_APPLICATIONS_USE_ACCELEROMETER=n
CONFIG_APPLICATIONS_USE_COMPASS=n
CONFIG_APPLICATIONS_USE_SENSORS_SUMMARY=n
CONFIG_APPLICATIONS_USE_X_RAY=n
CONFIG_APPLICATIONS_USE_QR_CODE=n
CONFIG_APPLICATIONS_USE_INFO=n
CONFIG_PICOLIBC=y
```

## src/main.c
```c
/*
 * This file is part of ZSWatch project <https://github.com/jakkra/ZSWatch/>.
 * Copyright (c) 2023 Jakob Krantz.
 *
 * This program is free software: you can redistribute it and/or modify
 * it under the terms of the GNU General Public License as published by
 * the Free Software Foundation, version 3.
 *
 * This program is distributed in the hope that it will be useful, but
 * WITHOUT ANY WARRANTY; without even the implied warranty of
 * MERCHANTABILITY or FITNESS FOR A PARTICULAR PURPOSE. See the GNU
 * General Public License for more details.
 *
 * You should have received a copy of the GNU General Public License
 * along with this program. If not, see <http://www.gnu.org/licenses/>.
 */

#include <zephyr/device.h>
#include <stdio.h>
#include <string.h>
#include <zephyr/kernel.h>
#include <zephyr/bluetooth/bluetooth.h>
#include <zephyr/settings/settings.h>
#include <zephyr/logging/log.h>
#include <zephyr/logging/log_ctrl.h>
#include <zsw_clock.h>
#include <lvgl.h>
#include <sys/time.h>
#include <zephyr/zbus/zbus.h>
#include <zsw_cpu_freq.h>
#include <zephyr/bluetooth/bluetooth.h>
#include <zephyr/task_wdt/task_wdt.h>
#include <zephyr/fatal.h>
#include <zephyr/input/input.h>
#include <zephyr/retention/bootmode.h>
#include <zephyr/sys/reboot.h>
#include "dfu.h"
#include "ui/zsw_ui.h"
#include "ble/ble_comm.h"
#include "ble/ble_aoa.h"
#include "battery/battery.h"
#include "battery/zsw_charger.h"
#include "events/accel_event.h"
#include "events/ble_data_event.h"
#include "sensors/zsw_imu.h"
#include "sensors/zsw_magnetometer.h"
#include "sensors/zsw_pressure_sensor.h"
#include <ram_retention_storage.h>
#include "drivers/zsw_vibration_motor.h"
#include "drivers/zsw_display_control.h"
#include "managers/zsw_power_manager.h"
#include "managers/zsw_app_manager.h"
#include "managers/zsw_notification_manager.h"
#include "applications/watchface/watchface_app.h"
#include <filesystem/zsw_rtt_flash_loader.h>

LOG_MODULE_REGISTER(main, LOG_LEVEL_WRN);

#define TASK_WDT_FEED_INTERVAL_MS  3000

typedef enum ui_state {
    INIT_STATE,
    WATCHFACE_STATE,
    APPLICATION_MANAGER_STATE,
} ui_state_t;

static struct input_worker_item_t {
    struct k_work work;
    struct input_event event;
} input_worker_item;

struct input_event last_input_event;

static void run_input_work(struct k_work *item);
static void run_init_work(struct k_work *item);

static void run_wdt_work(struct k_work *item);
static void enable_bluetoth(void);
static bool load_retention_ram(void);
static void enocoder_read(struct _lv_indev_drv_t *indev_drv, lv_indev_data_t *data);
static void click_feedback(struct _lv_indev_drv_t *drv, uint8_t e);
static void open_notification_popup(void *data);
static void async_turn_off_buttons_allocation(void *unused);
static void open_application_manager_page(void *app_name);
static void handle_screen_gesture(lv_dir_t event_code);

static void on_application_manager_close(void);
static void on_popup_notifcation_closed(uint32_t id);
static void on_ble_data_callback(ble_comm_cb_data_t *cb);
static void on_zbus_ble_data_callback(const struct zbus_channel *chan);
static void on_input_subsys_callback(struct input_event *evt);
static void on_watchface_app_event_callback(watchface_app_evt_t evt);
#if defined(CONFIG_BOARD_NATIVE_POSIX) || defined(CONFIG_BOARD_M5STACK_CORE2)
static void on_lvgl_screen_gesture_event_callback(lv_event_t *e);
#endif

static int kernal_wdt_id;

static lv_group_t *input_group;
static lv_group_t *temp_group;

static lv_indev_drv_t enc_drv;
static lv_indev_t *enc_indev;
static uint8_t last_pressed;

static bool pending_not_open;
static bool is_buttons_for_lvgl = false;

static ui_state_t watch_state = INIT_STATE;

K_WORK_DELAYABLE_DEFINE(wdt_work, run_wdt_work);
K_WORK_DEFINE(init_work, run_init_work);
K_WORK_DEFINE(input_work, run_input_work);

ZBUS_CHAN_DECLARE(ble_comm_data_chan);
ZBUS_LISTENER_DEFINE(main_ble_comm_lis, on_zbus_ble_data_callback);

static void run_input_work(struct k_work *item)
{
    struct input_worker_item_t *container = CONTAINER_OF(item, struct input_worker_item_t, work);

    LOG_DBG("Input worker code: %u", container->event.code);

    // Don't process the press if it caused wakeup.
    if (zsw_power_manager_reset_idle_timout()) {
        return;
    }

    switch (container->event.code) {
        // Button event
        // Always allow force restart.
        case (INPUT_KEY_Y): {
            LOG_INF("Force restart");

            retained.off_count += 1;
            retained_update();
            sys_reboot(SYS_REBOOT_COLD);

            break;
        }
        // Button event
        case INPUT_KEY_3: {
            if (zsw_notification_popup_is_shown()) {
                zsw_notification_popup_remove();
            } else if (watch_state == APPLICATION_MANAGER_STATE) {
                zsw_app_manager_exit_app();

                return;
            }

            break;
        }
        case INPUT_KEY_1: {
            if ((watch_state == WATCHFACE_STATE) && !zsw_notification_popup_is_shown()) {
                zsw_vibration_run_pattern(ZSW_VIBRATION_PATTERN_CLICK);
                lv_async_call(open_application_manager_page, NULL);
            }

            break;
        }
    }

    // Handle the input events. We have to take care about the screen orientation for the touch events.
    lv_dir_t gesture_code = LV_DIR_NONE;
    switch (container->event.code) {
        // Watch: Slide from right to left.
        case INPUT_BTN_NORTH: {
            gesture_code = LV_DIR_LEFT;
            break;
        }
        // Watch: Slide from left to right.
        case INPUT_BTN_SOUTH: {
            gesture_code = LV_DIR_RIGHT;
            break;
        }
        // Watch: Slide from bottom to top.
        case INPUT_BTN_WEST: {
            gesture_code = LV_DIR_TOP;
            break;
        }
        // Watch: Slide from top to bottom.
        case INPUT_BTN_EAST: {
            gesture_code = LV_DIR_BOTTOM;
            break;
        }
    }

    if (is_buttons_for_lvgl && (gesture_code == LV_DIR_NONE)) {
        // Handled by LVGL
        last_input_event.code = container->event.code;
        return;
    }

    if (gesture_code != LV_DIR_NONE) {
        handle_screen_gesture(gesture_code);
    }
}

static void run_init_work(struct k_work *item)
{
    lv_indev_t *touch_indev;

    load_retention_ram();
    zsw_notification_manager_init();
    enable_bluetoth();
    zsw_imu_init();
    zsw_magnetometer_init();
    zsw_pressure_sensor_init();
    zsw_clock_init(retained.current_time_seconds);
    // Not to self, PWM consumes like 250uA...
    // Need to disable also when screen is off.
    zsw_display_control_init();
    zsw_display_control_sleep_ctrl(true);

    INPUT_CALLBACK_DEFINE(NULL, on_input_subsys_callback);

    lv_indev_drv_init(&enc_drv);
    enc_drv.type = LV_INDEV_TYPE_ENCODER;
    enc_drv.read_cb = enocoder_read;
    enc_drv.feedback_cb = click_feedback;
    enc_indev = lv_indev_drv_register(&enc_drv);

    input_group = lv_group_create();
    temp_group = lv_group_create();
    lv_group_set_default(input_group);
    lv_indev_set_group(enc_indev, input_group);

    touch_indev = lv_indev_get_next(NULL);
    while (touch_indev) {
        if (lv_indev_get_type(touch_indev) == LV_INDEV_TYPE_POINTER) {
            // TODO First fix so not all presses everywhere are registered as clicks and cause vibration
            // Clicking anywehere with this below added right now will cause a vibration, which
            // is not what we want
            // touch_indev->driver->feedback_cb = click_feedback;
            break;
        }
        touch_indev = lv_indev_get_next(touch_indev);
    }

    watch_state = WATCHFACE_STATE;

#if defined(CONFIG_BOARD_NATIVE_POSIX) || defined(CONFIG_BOARD_M5STACK_CORE2)
    lv_obj_add_event_cb(lv_scr_act(), on_lvgl_screen_gesture_event_callback, LV_EVENT_GESTURE, NULL);
#endif

    watchface_app_start(input_group, on_watchface_app_event_callback);
}

void run_wdt_work(struct k_work *item)
{
    task_wdt_feed(kernal_wdt_id);
    k_work_schedule(&wdt_work, K_MSEC(TASK_WDT_FEED_INTERVAL_MS));
}

int main(void)
{
#ifdef CONFIG_SPI_FLASH_LOADER
    if (bootmode_check(0xA)) {
        LOG_WRN("SPI Flash Loader Boot Mode");
        bootmode_clear();
        zsw_rtt_flash_loader_start();
        return 0;
    }
#endif
#if defined(CONFIG_TASK_WDT) && !defined(CONFIG_BOARD_NATIVE_POSIX)
    const struct device *hw_wdt_dev = DEVICE_DT_GET(DT_ALIAS(watchdog0));
    if (!device_is_ready(hw_wdt_dev)) {
        printk("Hardware watchdog %s is not ready; ignoring it.\n",
               hw_wdt_dev->name);
        hw_wdt_dev = NULL;
    }

    task_wdt_init(hw_wdt_dev);
    kernal_wdt_id = task_wdt_add(TASK_WDT_FEED_INTERVAL_MS * 2, NULL, NULL);

    k_work_schedule(&wdt_work, K_NO_WAIT);
#endif
    // The init code requires a bit of stack.
    // So in order to not increase CONFIG_MAIN_STACK_SIZE and loose
    // this RAM forever, instead re-use the system workqueue for init
    // it has the required amount of stack.
    k_work_submit(&init_work);

    return 0;
}

static void enable_bluetoth(void)
{
    int err;

#if defined(CONFIG_BOARD_NATIVE_POSIX) || defined(CONFIG_BOARD_M5STACK_CORE2)
    bt_addr_le_t addr;

    err = bt_addr_le_from_str("DE:AD:BE:EF:BA:11", "random", &addr);
    if (err) {
        LOG_ERR("Invalid BT address (err %d)", err);
    }

    err = bt_id_create(&addr, NULL);
    if (err < 0) {
        LOG_ERR("Creating new ID failed (err %d)", err);
    }
#endif

    err = bt_enable(NULL);

#ifdef CONFIG_SETTINGS
    settings_load();
#endif
    if (err != 0) {
        LOG_ERR("Failed to enable Bluetooth, err: %d", err);
        return;
    }

    __ASSERT_NO_MSG(ble_comm_init(on_ble_data_callback) == 0);
    bleAoaInit();
}

static bool load_retention_ram(void)
{
    bool retained_ok = retained_validate();
    //memset(&retained, 0, sizeof(retained));
    /* Increment for this boot attempt and update. */
    retained.boots += 1;
    retained_update();

    LOG_DBG("Retained data: %s\n", retained_ok ? "valid" : "INVALID");
    LOG_DBG("Boot count: %u\n", retained.boots);
    LOG_DBG("uptime_latest: %" PRIu64 "\n", retained.uptime_latest);
    LOG_DBG("Active Ticks: %" PRIu64 "\n", retained.uptime_sum);

    return retained_ok;
}

static void open_notification_popup(void *data)
{
    zsw_not_mngr_notification_t *not = zsw_notification_manager_get_newest();
    if (not != NULL) {
        lv_group_set_default(temp_group);
        lv_indev_set_group(enc_indev, temp_group);
        zsw_vibration_run_pattern(ZSW_VIBRATION_PATTERN_NOTIFICATION);
        zsw_notification_popup_show(not->title, not->body, not->src, not->id, on_popup_notifcation_closed, 10);
        is_buttons_for_lvgl = true;
    }
    pending_not_open = false;
}

static void open_application_manager_page(void *app_name)
{
    watchface_app_stop();
    is_buttons_for_lvgl = true;
    watch_state = APPLICATION_MANAGER_STATE;
    zsw_app_manager_show(on_application_manager_close, lv_scr_act(), input_group, (char *)app_name);
}

static void close_popup_notification(lv_timer_t *timer)
{
    int msg_len;
    char buf[100];
    uint32_t id;

    id = (uint32_t)timer->user_data;
    // Notification was dismissed, hence consider it read.
    zsw_notification_manager_remove(id);

    lv_group_set_default(input_group);
    lv_indev_set_group(enc_indev, input_group);
    if (watch_state == WATCHFACE_STATE) {
        is_buttons_for_lvgl = 0;
    } else {
        is_buttons_for_lvgl = 1;
    }

    memset(buf, 0, sizeof(buf));

    // Send to phone notification read => It will be remove on phone too.
    msg_len = snprintf(buf, sizeof(buf), "{\"t\":\"notify\", \"id\": %d, \"n\": %s} \n", id, "\"DISMISS\"");
    ble_comm_send(buf, msg_len);
}

static void on_popup_notifcation_closed(uint32_t id)
{
    lv_timer_t *timer;
    // Changing back input group directly here causes LVGL
    // to not remove the notifcation for some reason.
    // Maybe a bug, or something done wrong.
    // Anyway doing it after a while instead seems to fix
    // the problem.
    timer = lv_timer_create(close_popup_notification, 500,  (void *)id);
    lv_timer_set_repeat_count(timer, 1);
}

static void on_application_manager_close(void)
{
    zsw_app_manager_delete();
    watch_state = WATCHFACE_STATE;
    watchface_app_start(input_group, on_watchface_app_event_callback);
    lv_async_call(async_turn_off_buttons_allocation, NULL);
}

static void async_turn_off_buttons_allocation(void *unused)
{
    is_buttons_for_lvgl = false;
}

static void on_input_subsys_callback(struct input_event *evt)
{
    // Currently you have to define a keycode as binding between buttons and longpress. We skip this binding codes for now.
    // Also touch events will be skipped, because they are handled by LVGL.
    // TODO: Charger is also ignored for now.
    // TODO: Replace this filtering with a propper device filtering setup for the input handler
    if ((evt->code == INPUT_ABS_X) || (evt->code == INPUT_ABS_Y) || (evt->code == INPUT_BTN_TOUCH) ||
        (evt->code == INPUT_KEY_KP0) || (evt->code == INPUT_KEY_POWER) || (evt->value == 1)) {
        return;
    }

    input_worker_item.event = *evt;
    input_worker_item.work = input_work;
    k_work_submit(&input_worker_item.work);
}

static void handle_screen_gesture(lv_dir_t event_code)
{
    if (watch_state == WATCHFACE_STATE && !zsw_notification_popup_is_shown()) {
        switch (event_code) {
            case LV_DIR_LEFT: {
                open_application_manager_page("Notification");
                break;
            }
            case LV_DIR_RIGHT: {
                watchface_change();
                break;
            }
            case LV_DIR_TOP: {
                open_application_manager_page("Settings");
                break;
            }
            case LV_DIR_BOTTOM: {
                open_application_manager_page(NULL);
                break;
            }
            default:
                __ASSERT(false, "Not a valid gesture code: %d", event_code);
        }
        lv_indev_wait_release(lv_indev_get_act());
    } else if (zsw_notification_popup_is_shown()) {
        zsw_notification_popup_remove();
    } else if (watch_state == APPLICATION_MANAGER_STATE && event_code == LV_DIR_RIGHT) {
#if defined(CONFIG_BOARD_NATIVE_POSIX) || defined(CONFIG_BOARD_M5STACK_CORE2)
        // Until there is a better way to go back without access to buttons.
        zsw_app_manager_exit_app();
#endif
    }
}

#if defined(CONFIG_BOARD_NATIVE_POSIX) || defined(CONFIG_BOARD_M5STACK_CORE2)
static void on_lvgl_screen_gesture_event_callback(lv_event_t *e)
{
    lv_dir_t  dir;
    lv_event_code_t event = lv_event_get_code(e);
    if (event == LV_EVENT_GESTURE) {
        dir = lv_indev_get_gesture_dir(lv_indev_get_act());
        handle_screen_gesture(dir);
    }
}
#endif

static void enocoder_read(struct _lv_indev_drv_t *indev_drv, lv_indev_data_t *data)
{
    if (!is_buttons_for_lvgl) {
        return;
    }

    if (last_input_event.code == INPUT_KEY_4) {
        data->key = LV_KEY_LEFT;
        data->state = LV_INDEV_STATE_PR;
        last_pressed = 2;
    } else if (last_input_event.code == INPUT_KEY_1) {
        data->key = LV_KEY_ENTER;
        data->state = LV_INDEV_STATE_PR;
        last_pressed = 1;
    } else if (last_input_event.code == INPUT_KEY_2) {
        data->key = LV_KEY_RIGHT;
        data->state = LV_INDEV_STATE_PR;
        last_pressed = 3;
    } else if (last_input_event.code == INPUT_KEY_3) {
        // Not used for now. TODO exit/back button.
    } else {
        if (last_pressed == 0xFF) {
            return;
        }
        data->state = LV_INDEV_STATE_REL;
        switch (last_pressed) {
            case 2:
                data->key = LV_KEY_RIGHT;
                break;
            case 1:
                data->key = LV_KEY_ENTER;
                break;
            case 3:
                data->key = LV_KEY_LEFT;
                break;
            default:
                break;
        }
        last_pressed = 0xFF;
    }

    last_input_event.code = 0xFF;
}

static void on_watchface_app_event_callback(watchface_app_evt_t evt)
{
    if (watch_state == WATCHFACE_STATE && !zsw_notification_popup_is_shown()) {
        switch (evt) {
            case WATCHFACE_APP_EVT_CLICK_BATT:
                open_application_manager_page("Battery");
                break;
            case WATCHFACE_APP_EVT_CLICK_STEP:
                break;
            case WATCHFACE_APP_EVT_CLICK_WEATHER:
                break;
            default:
                break;
        }
    }
}

static void click_feedback(struct _lv_indev_drv_t *drv, uint8_t e)
{
    if (e == LV_EVENT_CLICKED) {
        zsw_vibration_run_pattern(ZSW_VIBRATION_PATTERN_CLICK);
    }
}

static void on_ble_data_callback(ble_comm_cb_data_t *cb)
{
    zsw_not_mngr_notification_t *parsed_not;

    switch (cb->type) {
        case BLE_COMM_DATA_TYPE_NOTIFY:
            parsed_not = zsw_notification_manager_add(&cb->data.notify);
            if (!parsed_not) {
                return;
            }

            if (zsw_notification_popup_is_shown() || pending_not_open) {
                return;
            }

            pending_not_open = true;

            if (zsw_power_manager_get_state() != ZSW_ACTIVITY_STATE_NOT_WORN_STATIONARY) {
                zsw_power_manager_reset_idle_timout();
                lv_async_call(open_notification_popup, NULL);
            }
            break;

        default:
            break;
    }
}

static void on_zbus_ble_data_callback(const struct zbus_channel *chan)
{
    const struct ble_data_event *event = zbus_chan_const_msg(chan);
    switch (event->data.type) {
        case BLE_COMM_DATA_TYPE_NOTIFY:
            // TODO, this one not supported yet through events
            // Handled in ble_comm callback for now
            break;
        case BLE_COMM_DATA_TYPE_NOTIFY_REMOVE:
            if (zsw_notification_manager_remove(event->data.data.notify_remove.id) != 0) {
                LOG_WRN("Notification %d not found", event->data.data.notify_remove.id);
            }
            break;
        case BLE_COMM_DATA_TYPE_SET_TIME: {
            struct timespec tspec;
            tspec.tv_sec = event->data.data.time.seconds;
            tspec.tv_nsec = 0;
            clock_settime(CLOCK_REALTIME, &tspec);
            break;
        }
        case BLE_COMM_DATA_TYPE_WEATHER:
            break;
        case BLE_COMM_DATA_TYPE_REMOTE_CONTROL:
            // TODO: Add correct enum
            if (event->data.data.remote_control.button == 4) {
                zsw_power_manager_reset_idle_timout();
                if (watch_state == APPLICATION_MANAGER_STATE) {
                    zsw_app_manager_delete();
                    zsw_app_manager_set_index(0);
                    is_buttons_for_lvgl = false;
                    watch_state = WATCHFACE_STATE;
                    watchface_app_start(input_group, on_watchface_app_event_callback);
                }
            } else {
                // TODO: Can we rework it with triggering input events?
                //button_set_fake_press((buttonId_t)event->data.data.remote_control.button, true);
            }

            break;
        default:
            break;
    }
}

void k_sys_fatal_error_handler(unsigned int reason, const z_arch_esf_t *esf)
{
    ARG_UNUSED(esf);
    ARG_UNUSED(reason);

    LOG_PANIC();

    LOG_ERR("Resetting system");
    sys_reboot(SYS_REBOOT_COLD);

    CODE_UNREACHABLE;
}
```

## src/ram_retention_storage.c
```c
/*
 * Copyright (c) 2021 Nordic Semiconductor ASA
 *
 * SPDX-License-Identifier: Apache-2.0
 */
#include <string.h>
#include <zephyr/kernel.h>
#include "ram_retention_storage.h"
#if !defined(CONFIG_BOARD_NATIVE_POSIX) && !defined(CONFIG_BOARD_M5STACK_CORE2)
#include <zephyr/devicetree.h>
#include <zephyr/sys/byteorder.h>
#include <zephyr/sys/crc.h>
#include <hal/nrf_power.h>

/* nRF52 RAM (really, RAM AHB slaves) are partitioned as:
 * * Up to 8 blocks of two 4 KiBy byte "small" sections
 * * A 9th block of with 32 KiBy "large" sections
 *
 * At time of writing the maximum number of large sections is 6, all
 * within the first large block.  Theoretically there could be more
 * sections in the 9th block, and possibly more blocks.
 */

/* Inclusive address of RAM start */
#define SRAM_BEGIN (uintptr_t)DT_REG_ADDR(DT_NODELABEL(sram0))

/* Exclusive address of RAM end */
#define SRAM_END (SRAM_BEGIN + (uintptr_t)DT_REG_SIZE(DT_NODELABEL(sram0)))

/* Size of a controllable RAM section in the small blocks */
#define SMALL_SECTION_SIZE 4096

/* Number of controllable RAM sections in each of the lower blocks */
#define SMALL_SECTIONS_PER_BLOCK 2

/* Span of a small block */
#define SMALL_BLOCK_SIZE (SMALL_SECTIONS_PER_BLOCK * SMALL_SECTION_SIZE)

/* Number of small blocks */
#define SMALL_BLOCK_COUNT 8

/* Span of the SRAM area covered by small sections */
#define SMALL_SECTION_SPAN (SMALL_BLOCK_COUNT * SMALL_BLOCK_SIZE)

/* Inclusive address of the RAM range covered by large sections */
#define LARGE_SECTION_BEGIN (SRAM_BEGIN + SMALL_SECTION_SPAN)

/* Size of a controllable RAM section in large blocks */
#define LARGE_SECTION_SIZE 32768

/* Set or clear RAM retention in SYSTEM_OFF for the provided object.
 *
 * @note This only works for nRF52 with the POWER module.  The other
 * Nordic chips use a different low-level API, which is not currently
 * used by this function.
 *
 * @param ptr pointer to the start of the retainable object
 *
 * @param len length of the retainable object
 *
 * @param enable true to enable retention, false to clear retention
 */
static int ram_range_retain(const void *ptr,
                            size_t len,
                            bool enable)
{
    uintptr_t addr = (uintptr_t)ptr;
    uintptr_t addr_end = addr + len;

    /* Error if the provided range is empty or doesn't lie
     * entirely within the SRAM address space.
     */
    if ((len == 0U)
        || (addr < SRAM_BEGIN)
        || (addr > (SRAM_END - len))) {
        return -EINVAL;
    }

    /* Iterate over each section covered by the range, setting the
     * corresponding RAM OFF retention bit in the parent block.
     */
    do {
        uintptr_t block_base = SRAM_BEGIN;
        uint32_t section_size = SMALL_SECTION_SIZE;
        uint32_t sections_per_block = SMALL_SECTIONS_PER_BLOCK;
        bool is_large = (addr >= LARGE_SECTION_BEGIN);
        uint8_t block = 0;

        if (is_large) {
            block = 8;
            block_base = LARGE_SECTION_BEGIN;
            section_size = LARGE_SECTION_SIZE;

            /* RAM[x] supports only 16 sections, each its own bit
             * for POWER (0..15) and RETENTION (16..31).  We don't
             * know directly how many sections are present, so
             * assume they all are; the true limit will be
             * determined by the SRAM size.
             */
            sections_per_block = 16;
        }

        uint32_t section = (addr - block_base) / section_size;

        if (section >= sections_per_block) {
            block += section / sections_per_block;
            section %= sections_per_block;
        }

        //uint32_t section_mask =
        //    (VMC_RAM_POWERSET_S0RETENTION_On
        //     << (section + VMC_RAM_POWERSET_S0RETENTION_Pos));

        // TODO, RAM retention works differently on nRF5340
        //if (enable) {
        //    nrf_vmc_ram_block_power_set(NRF_VMC, block, section_mask);
        //} else {
        //    nrf_vmc_ram_block_power_set(NRF_VMC, block, section_mask);
        //}

        /* Move to the first address in the next section. */
        addr += section_size - (addr % section_size);
    } while (addr < addr_end);

    return 0;
}

/* Retained data must be defined in a no-init section to prevent the C
 * runtime initialization from zeroing it before anybody can see it.
 */
__noinit struct retained_data retained;

#define RETAINED_CRC_OFFSET offsetof(struct retained_data, crc)
#define RETAINED_CHECKED_SIZE (RETAINED_CRC_OFFSET + sizeof(retained.crc))

bool retained_validate()
{
    /* The residue of a CRC is what you get from the CRC over the
     * message catenated with its CRC.  This is the post-final-xor
     * residue for CRC-32 (CRC-32/ISO-HDLC) which Zephyr calls
     * crc32_ieee.
     */
    const uint32_t residue = 0x2144df1c;
    uint32_t crc = crc32_ieee((const uint8_t *)&retained,
                              RETAINED_CHECKED_SIZE);
    bool valid = (crc == residue);

    /* If the CRC isn't valid, reset the retained data. */
    if (!valid) {
        memset(&retained, 0, sizeof(retained));
    }

    /* Reset to accrue runtime from this session. */
    retained.uptime_latest = 0;

    /* Reconfigure to retain the state during system off, regardless of
     * whether validation succeeded.  Although these values can sometimes
     * be observed to be preserved across System OFF, the product
     * specification states they are not retained in that situation, and
     * that can also be observed.
     */
    ram_range_retain(&retained, RETAINED_CHECKED_SIZE, true);

    return valid;
}

void retained_update(void)
{
    uint64_t now = k_uptime_get();

    retained.uptime_sum += (now - retained.uptime_latest);
    retained.uptime_latest = now;

    uint32_t crc = crc32_ieee((const uint8_t *)&retained,
                              RETAINED_CRC_OFFSET);

    retained.crc = sys_cpu_to_le32(crc);
}

void retained_reset(void)
{
    memset(&retained, 0, sizeof(retained));
    retained_update();
}

#else
struct retained_data retained;
bool retained_validate()
{
    return 0;
}

void retained_update(void)
{

}

void retained_reset(void)
{
}
#endif
```

## src/zsw_cpu_freq.c
```c
/*
 * This file is part of ZSWatch project <https://github.com/jakkra/ZSWatch/>.
 * Copyright (c) 2023 Jakob Krantz.
 *
 * This program is free software: you can redistribute it and/or modify
 * it under the terms of the GNU General Public License as published by
 * the Free Software Foundation, version 3.
 *
 * This program is distributed in the hope that it will be useful, but
 * WITHOUT ANY WARRANTY; without even the implied warranty of
 * MERCHANTABILITY or FITNESS FOR A PARTICULAR PURPOSE. See the GNU
 * General Public License for more details.
 *
 * You should have received a copy of the GNU General Public License
 * along with this program. If not, see <http://www.gnu.org/licenses/>.
 */

#include <zsw_cpu_freq.h>
#include <zephyr/kernel.h>
#if !defined(CONFIG_BOARD_NATIVE_POSIX) && !defined(CONFIG_BOARD_M5STACK_CORE2)
#include <nrfx_clock.h>

//#define CPU_CLOCK_PROFILING

void zsw_cpu_set_freq(zsw_cpu_freq_t freq, bool wait)
{
#ifdef CLOCK_FEATURE_HFCLK_DIVIDE_PRESENT
    int ret;
#ifdef CPU_CLOCK_PROFILING
    uint32_t start_time;
    uint32_t stop_time;
    uint32_t cycles_spent;
    uint32_t nanoseconds_spent;
    start_time = k_cycle_get_32();
#endif

    // This configures the clock for CPU APP Core
    ret = nrfx_clock_divider_set(NRF_CLOCK_DOMAIN_HFCLK,
                                 freq == ZSW_CPU_FREQ_FAST ? NRF_CLOCK_HFCLK_DIV_1 : NRF_CLOCK_HFCLK_DIV_2);

    ret -= NRFX_ERROR_BASE_NUM;
    if (ret) {
        return;
    }

    // Wait if requested for the clock to start/stop
    if (freq == ZSW_CPU_FREQ_FAST && wait) {
        nrfx_clock_start(NRF_CLOCK_DOMAIN_HFCLK);
        while (!nrfx_clock_is_running(NRF_CLOCK_DOMAIN_HFCLK, NULL)) {
        }
    } else if (freq == ZSW_CPU_FREQ_DEFAULT && wait) {
        nrfx_clock_stop(NRF_CLOCK_DOMAIN_HFCLK);
        while (nrfx_clock_is_running(NRF_CLOCK_DOMAIN_HFCLK, NULL)) {
        }
    }
#ifdef CPU_CLOCK_PROFILING
    stop_time = k_cycle_get_32();
    cycles_spent = stop_time - start_time;
    nanoseconds_spent = k_cyc_to_ns_ceil32(cycles_spent);
    if (freq == ZSW_CPU_FREQ_FAST) {
        printk("Start HFCLK took: %dns\n", nanoseconds_spent);
    } else {
        printk("Stop HFCLK took: %dns\n", nanoseconds_spent);
    }
#endif
#endif
}

zsw_cpu_freq_t zsw_cpu_get_freq(void)
{
#ifdef CLOCK_FEATURE_HFCLK_DIVIDE_PRESENT
    if (nrf_clock_hfclk_div_get(NRF_CLOCK) == NRF_CLOCK_HFCLK_DIV_1) {
        return ZSW_CPU_FREQ_FAST;
    } else {
        return ZSW_CPU_FREQ_DEFAULT;
    }
#else
    return ZSW_CPU_FREQ_DEFAULT;
#endif
}
#else
void zsw_cpu_set_freq(zsw_cpu_freq_t freq, bool wait) {}

zsw_cpu_freq_t zsw_cpu_get_freq(void)
{
    return ZSW_CPU_FREQ_DEFAULT;
}
#endif
```
